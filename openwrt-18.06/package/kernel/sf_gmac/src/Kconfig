## openwrt-18.06/package/kernel/sf_gmac/src/Kconfig
```kconfig
config NET_VENDOR_SIFLOWER
	tristate "vender siflower switch driver support sfax8"
	help
	  This driver supports the ethernet/switch inside

if NET_VENDOR_SIFLOWER

config SFAX8_GMAC
tristate "vender siflower GMAC Ethernet driver support sf16AX8"
	select CRC32
	select MII
	select PHYLIB
	select PTP_1588_CLOCK
	help
	  This driver supports RGMII/RMII mode GMAC

config SFAX8_RGMII_GMAC
	bool "select RGMII mode gmac"
	depends on (SFAX8_GMAC)

config SFAX8_RMII_GMAC
	bool "select RMII mode gmac"
	depends on (SFAX8_GMAC)
endif
```
